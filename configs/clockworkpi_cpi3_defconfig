## configs/clockworkpi_cpi3_defconfig
```kconfig
CONFIG_ARM=y
CONFIG_ARCH_SUNXI=y
CONFIG_DEFAULT_DEVICE_TREE="sun8i-r16-clockworkpi-cpi3"
CONFIG_SPL_TEXT_BASE=0x60
CONFIG_SPL=y
CONFIG_MACH_SUN8I_A33=y
CONFIG_DRAM_CLK=432
CONFIG_DRAM_ZQ=15291
CONFIG_DRAM_ODT_EN=y
CONFIG_AXP_GPIO=y
CONFIG_VIDEO_LCD_MODE="x:320,y:240,depth:18,pclk_khz:5800,le:60,ri:6,up:6,lo:2,hs:2,vs:2,sync:0,vmode:0"
CONFIG_VIDEO_LCD_BL_EN="PH1"
# CONFIG_SYS_MALLOC_CLEAR_ON_INIT is not set
CONFIG_CMD_DFU=y
CONFIG_CMD_USB_MASS_STORAGE=y
CONFIG_FASTBOOT_CMD_OEM_FORMAT=y
CONFIG_AXP_DLDO1_VOLT=3300
CONFIG_AXP_DLDO2_VOLT=3300
CONFIG_AXP_DLDO3_VOLT=3300
CONFIG_AXP_DLDO4_VOLT=3300
CONFIG_USB_EHCI_HCD=y
CONFIG_USB_OHCI_HCD=y
CONFIG_USB_MUSB_GADGET=y
```
